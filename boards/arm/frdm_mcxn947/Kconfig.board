## boards/arm/frdm_mcxn947/Kconfig.board
```kconfig
# Copyright 2023 NXP
# SPDX-License-Identifier: Apache-2.0

config BOARD_FRDM_MCXN947_CPU0
	bool "NXP MCXN947 [CPU0]"
	depends on SOC_SERIES_MCX_N94X
	select SOC_PART_NUMBER_MCXN947VDF

config BOARD_FRDM_MCXN947_CPU1
	bool "NXP MCXN947 [CPU1]"
	depends on SOC_SERIES_MCX_N94X
	select SOC_PART_NUMBER_MCXN947VDF
```

## boards/arm/frdm_mcxn947/Kconfig.defconfig
```kconfig
# Copyright 2023 NXP
# SPDX-License-Identifier: Apache-2.0

if BOARD_FRDM_MCXN947_CPU0 || BOARD_FRDMMCXN947_CPU1

config BOARD
	default "frdm_mcxn947_cpu0" if BOARD_FRDM_MCXN947_CPU0
	default "frdm_mcxn947_cpu1" if BOARD_FRDM_MCXN947_CPU1

choice FLASH_MCUX_FLEXSPI_XIP_MEM_TARGET
	default FLASH_MCUX_FLEXSPI_XIP_MEM_SRAM
endchoice


endif # BOARD_FRDM_MCXN947_CPU0 || BOARD_FRDM_MCXN947_CPU1
```

## boards/arm/frdm_mcxn947/frdm_mcxn947_cpu0_defconfig
```kconfig
#
# Copyright 2023 NXP
#
# SPDX-License-Identifier: Apache-2.0
#

CONFIG_SOC_SERIES_MCX_N94X=y
CONFIG_SOC_MCX_N947_CPU0=y
CONFIG_BOARD_FRDM_MCXN947_CPU0=y
CONFIG_CONSOLE=y
CONFIG_UART_CONSOLE=y
CONFIG_SERIAL=y
CONFIG_UART_INTERRUPT_DRIVEN=y
CONFIG_GPIO=y
CONFIG_PINCTRL=y

CONFIG_ARM_MPU=y
CONFIG_HW_STACK_PROTECTION=y

# Enable TrustZone-M
CONFIG_TRUSTED_EXECUTION_SECURE=y
```

## boards/arm/frdm_mcxn947/frdm_mcxn947_cpu1_defconfig
```kconfig
#
# Copyright 2023 NXP
#
# SPDX-License-Identifier: Apache-2.0
#

CONFIG_SOC_SERIES_MCX_N94X=y
CONFIG_SOC_MCX_N947_CPU1=y
CONFIG_BOARD_FRDM_MCXN947_CPU1=y
CONFIG_GPIO=y
CONFIG_PINCTRL=y
```

## boards/arm/mcxn9xxbrk/Kconfig.board
```kconfig
# Copyright 2023 NXP
# SPDX-License-Identifier: Apache-2.0

config BOARD_MCXN9XXBRK_CPU0
	bool "NXP MCX N9XX-BRK [CPU0]"
	depends on SOC_SERIES_MCX_N94X
	select SOC_PART_NUMBER_MCXN947VDF

config BOARD_MCXN9XXBRK_CPU1
	bool "NXP MCX N9XX-BRK [CPU1]"
	depends on SOC_SERIES_MCX_N94X
	select SOC_PART_NUMBER_MCXN947VDF
```

## boards/arm/mcxn9xxbrk/Kconfig.defconfig
```kconfig
# Copyright 2023 NXP
# SPDX-License-Identifier: Apache-2.0

if BOARD_MCXN9XXBRK_CPU0 || BOARD_MCXN9XXBRK_CPU1

config BOARD
	default "mcxn9xxbrk_cpu0" if BOARD_MCXN9XXBRK_CPU0
	default "mcxn9xxbrk_cpu1" if BOARD_MCXN9XXBRK_CPU1

endif # BOARD_MCXN9XXBRK_CPU0 || BOARD_MCXN9XXBRK_CPU1
```

## drivers/display/Kconfig.mcux_flexio_lcdif
```kconfig
# Copyright 2023 NXP
# SPDX-License-Identifier: Apache-2.0


menuconfig DISPLAY_MCUX_FLEXIO_LCDIF
	bool "MCUX FlexIO LCDIF driver"
	default y
	depends on DT_HAS_NXP_FLEXIO_LCDIF_ENABLED
	depends on CLOCK_CONTROL
	select MCUX_FLEXIO
	select DMA
	help
	  Enable support for mcux FlexIO LCDIF driver.
```

## drivers/display/Kconfig.ssd1963
```kconfig
# Copyright 2023, NXP Semiconductor
#
# SPDX-License-Identifier: Apache-2.0

config SSD1963
	bool "SSD1963 compatible display controller driver"
	default y
	depends on DT_HAS_SOLOMON_SSD1963_ENABLED
	select MIPI_DBI
	help
	  Enable driver for SSD1963 compatible controller.
```

## drivers/mipi_dbi/Kconfig.mcux
```kconfig
# Copyright 2024 NXP
# SPDX-License-Identifier: Apache-2.0

config MIPI_DBI_MCUX_FLEXIO
	bool "MIPI DBI MCUX driver"
	default y
	depends on DT_HAS_NXP_MIPI_DBI_FLEXIO_LCDIF_ENABLED
	select MCUX_FLEXIO
	help
	  Enable support for MIPI DBI SPI driver. This driver implements
	  a MIPI-DBI mode C compatible controller using a SPI device, as well
	  as GPIO outputs for the reset and D/C signals
```

## drivers/misc/mcux_flexio/Kconfig
```kconfig
# Copyright (c) 2023, STRIM, ALC
# SPDX-License-Identifier: Apache-2.0

config MCUX_FLEXIO
	bool
	depends on CLOCK_CONTROL
	help
	  Enable the FlexIO.
	  FlexIO is not used separately.

config MCUX_FLEXIO_INIT_PRIORITY
	int "Init priority"
	depends on MCUX_FLEXIO
	default 50
	help
	  MCUX FlexIO device driver initialization priority.

config MCUX_FLEXIO_CHILD_INIT_PRIORITY
	int "Init priority"
	depends on MCUX_FLEXIO
	default 51
	help
	  MCUX FlexIO Child device driver initialization priority.
	  Must be greater than MCUX_FLEXIO_INIT_PRIORITY.
```

## drivers/misc/mcux_lp_flexcomm/Kconfig
```kconfig
# Copyright 2023 NXP
#
# SPDX-License-Identifier: Apache-2.0

config MCUX_LP_FLEXCOMM
	bool "Driver for the NXP Low Power FlexComm Interface"
	default y
	depends on DT_HAS_NXP_LP_FLEXCOMM_ENABLED
	help
	  Enabled the Low Power FlexComm shim driver.
	  LP FLexcomm allows enablement of LPUART and LPI2C
	  at the same time with reduced interface. This driver
	  checks concurrent enablement and returns and error for
	  unsupported concurrent enablement.
```

## dts/bindings/display/nxp,flexio-lcdif.yaml
```yaml
# Copyright 2023 NXP
# SPDX-License-Identifier: Apache-2.0

description: NXP FlexIO LCD controller

compatible: "nxp,flexio-lcdif"

include: [base.yaml, imx-flexio-common.yaml]

properties:
  enwr-pin:
    type: int
    required: true
    description: |
      Pin select for WR(8080 mode), EN(6800 mode).

  rd-pin:
    type: int
    description: |
      Pin select for RD(8080 mode), not used in 6800 mode.

  data-pin-start:
    type: int
    required: true
    description: |
      Start index of the data pin.

  bus-type:
    type: int
    required: true
    enum:
      - 0 # Using Intel 8080 bus
      - 1 # Using MOtorola 6800 bus.
    description: |
      The Motorola 68K and Intel 8080 bus are two parallel interfaces
      commonly used by LCD controllers.

  baudrate-bps:
    type: int
    required: true
    description: |
      Baud rate in bit-per-second for all data lines combined.

  cs-gpios:
    type: phandle-array
    required: true
    description: |
      CS Pin
      GPIO to drive the CS pin.

  rs-gpios:
    type: phandle-array
    required: true
    description: |
      RS Pin
      GPIO to drive the RS pin.

  rdwr-gpios:
    type: phandle-array
    description: |
      RDWR Pin
      GPIO to drive the RDWR pin. This is required for Motorola 68K bus.
```

## dts/bindings/display/solomon,ssd1963.yaml
```yaml
# Copyright 2023 NXP
# SPDX-License-Identifier: Apache-2.0

description: SSD1963 display controller

compatible: "solomon,ssd1963"

include: [mipi-dbi-device.yaml, lcd-controller.yaml]

properties:
  xtal-frequency:
    type: int
    description: |
      Crystal oscillator input frequency in Hz.

  data-bus-width:
    type: int
    required: true
    enum:
      - 8
      - 9
      - 12
      - 16
      - 18
      - 24
    description: |
      Data bus width between the host and SSD1963 controller.

  panel-data-width:
    type: int
    default: 0
    enum:
      - 0
      - 1
    description: |
      Panel Data width. Default is POR value.
      0 - 18-bit; 1 - 24-bit.
```

## dts/bindings/flash_controller/nxp,iap-mcx.yaml
```yaml
description: NXP MCX Flash Memory Module (FMU)

compatible: "nxp,iap-mcx"

include: flash-controller.yaml
```

## dts/bindings/mipi-dbi/mipi-dbi-device.yaml
```yaml
# Copyright 2023 NXP
# SPDX-License-Identifier: Apache-2.0
#
# Common fields for MIPI-DBI devices

include: [base.yaml, power.yaml]

on-bus: mipi-dbi

properties:
  mipi-dbi-mode:
    type: int
    required: true
    description: |
      MIPI-DBI formats. See dt-bindings/mipi_dbi/mipi_dbi.h

  mipi-max-frequency:
    type: int
    description: Maximum clock frequency of device's MIPI interface in Hz
```

## dts/bindings/misc/nxp,lp-flexcomm.yaml
```yaml
# Copyright 2023 NXP
#
# SPDX-License-Identifier: Apache-2.0

description: Lower Power Flexcomm node

compatible: "nxp,lp-flexcomm"

include: [base.yaml]

properties:
  reg:
    required: true

  interrupts:
    required: true
```

## samples/subsys/fs/littlefs/boards/frdm_mcxn947_cpu0.conf
```kconfig
#
# Copyright 2023 NXP
#
# SPDX-License-Identifier: Apache-2.0
#
CONFIG_FLASH_DISABLE_CACHE64=y
```

## soc/arm/nxp_mcx/Kconfig
```kconfig
# Copyright 2023 NXP
# SPDX-License-Identifier: Apache-2.0

config SOC_FAMILY_MCX
	bool
	select HAS_SEGGER_RTT

if SOC_FAMILY_MCX

config SOC_FAMILY
	string
	default "nxp_mcx"

source "soc/arm/nxp_mcx/*/Kconfig.soc"

config SOC_PART_NUMBER
	default SOC_PART_NUMBER_MCX_N94X if SOC_SERIES_MCX_N94X


endif # SOC_FAMILY_MCX
```

## soc/arm/nxp_mcx/Kconfig.defconfig
```kconfig
# Copyright 2023 NXP
# SPDX-License-Identifier: Apache-2.0

config SERIAL_INIT_PRIORITY
	default 55
	depends on SERIAL

source "soc/arm/nxp_mcx/*/Kconfig.defconfig.series"
```

## soc/arm/nxp_mcx/Kconfig.soc
```kconfig
# Copyright 2023 NXP
# SPDX-License-Identifier: Apache-2.0

source "soc/arm/nxp_mcx/*/Kconfig.series"
```

## soc/arm/nxp_mcx/n94x/Kconfig.defconfig.n947_cpu1
```kconfig
# Copyright 2023 NXP
# SPDX-License-Identifier: Apache-2.0

if SOC_MCX_N947_CPU1

config SOC
	default "mcxn947_cpu1"

if MCUX_OS_TIMER

config SYS_CLOCK_HW_CYCLES_PER_SEC
	default 1000000

endif # MCUX_OS_TIMER

if CORTEX_M_SYSTICK

config SYS_CLOCK_HW_CYCLES_PER_SEC
	default 150000000

endif # CORTEX_M_SYSTICK

endif # SOC_MCX_N947_CPU1
```

## soc/arm/nxp_mcx/n94x/Kconfig.defconfig.series
```kconfig
# Copyright 2023 NXP
# SPDX-License-Identifier: Apache-2.0

if SOC_SERIES_MCX_N94X

config SOC_SERIES
	default "n94x"

config NUM_IRQS
	default 155

config ROM_START_OFFSET
	default 0x400 if BOOTLOADER_MCUBOOT

config ZTEST_NO_YIELD
	default y if (PM && ZTEST)

DT_CHOSEN_Z_FLASH := zephyr,flash
DT_COMPAT_FLEXSPI := nxp,imx-flexspi

DT_CHOSEN_FLASH_NODE := $(dt_chosen_path,$(DT_CHOSEN_Z_FLASH))
DT_CHOSEN_FLASH_PARENT := $(dt_node_parent,$(DT_CHOSEN_FLASH_NODE))

DT_FLASH_PARENT_IS_FLEXSPI := $(dt_node_has_compat,$(DT_CHOSEN_FLASH_PARENT),$(DT_COMPAT_FLEXSPI))
DT_FLASH_HAS_SIZE_PROP := $(dt_node_has_prop,$(DT_CHOSEN_FLASH_NODE),size)

config FLASH_BASE_ADDRESS
	default $(dt_node_reg_addr_hex,$(DT_CHOSEN_FLASH_PARENT),1) \
		if $(DT_FLASH_PARENT_IS_FLEXSPI)

config FLASH_SIZE
	default $(dt_node_int_prop_int,$(DT_CHOSEN_FLASH_NODE),size,Kb) \
		if $(DT_FLASH_HAS_SIZE_PROP)

choice USB_MCUX_CONTROLLER_TYPE
	default USB_DC_NXP_EHCI
endchoice

config FLASH_MCUX_FLEXSPI_XIP
	bool
	default $(DT_FLASH_PARENT_IS_FLEXSPI)
	select XIP
	help
	  Allows for the soc to safely initialize the clocks for the
	  FlexSpi when planning to execute code in FlexSpi Memory.

if FLASH_MCUX_FLEXSPI_XIP

# Avoid RWW hazards by defaulting logging to disabled
choice FLASH_LOG_LEVEL_CHOICE
	default FLASH_LOG_LEVEL_OFF
endchoice

choice MEMC_LOG_LEVEL_CHOICE
	default MEMC_LOG_LEVEL_OFF
endchoice

endif

source "soc/arm/nxp_mcx/n94x/Kconfig.defconfig.n94*"

endif # SOC_SERIES_MCX_N94X
```

## soc/arm/nxp_mcx/n94x/Kconfig.series
```kconfig
# i.MX RT5XX Series

# Copyright (c) 2022, NXP
# SPDX-License-Identifier: Apache-2.0

config SOC_SERIES_MCX_N94X
	bool "MCX N94X Series Family MCU"
	select ARM
	select CPU_CORTEX_M33
	select CPU_CORTEX_M_HAS_DWT
	select SOC_FAMILY_MCX
	select CLOCK_CONTROL
	help
	  Enable support for MCX N94X Series MCU series
```

## soc/arm/nxp_mcx/n94x/Kconfig.soc
```kconfig
# Copyright 2023 NXP
# SPDX-License-Identifier: Apache-2.0

choice
	prompt "MCX N94X Series MCU Selection"
	depends on SOC_SERIES_MCX_N94X

config SOC_MCX_N947_CPU0
	bool "SOC_MCXN947 M33 [CPU 0]"
	select CPU_HAS_ARM_SAU
	select CPU_HAS_ARM_MPU
	select CPU_HAS_FPU
	select PLATFORM_SPECIFIC_INIT
	select ARMV8_M_DSP
	select ARM_TRUSTZONE_M
	select CPU_CORTEX_M_HAS_SYSTICK
	select HAS_MCUX
	select HAS_MCUX_CACHE
	select HAS_MCUX_FLEXCOMM

config SOC_MCX_N947_CPU1
	bool "SOC_MCXN947 M33 [CPU 1]"
	select CPU_CORTEX_M_HAS_SYSTICK

endchoice

if SOC_SERIES_MCX_N94X

config SOC_PART_NUMBER_MCXN947VDF
	bool

config SOC_PART_NUMBER_MCXN947VNL
	bool

config SOC_PART_NUMBER_MCX_N94X
	string
	default "MCXN947VDF" if SOC_PART_NUMBER_MCXN947VDF
	default "MCXN947VNL" if SOC_PART_NUMBER_MCXN947VNL

	help
	  This string holds the full part number of the SoC. It is a hidden
	  option that you should not set directly. The part number selection
	  choice defines the default value for this string.

config SECOND_CORE_MCUX
	bool "MCXN94X's second core"
	depends on HAS_MCUX
	help
	  Indicates the second core will be enabled, and the part will run
	  in dual core mode.

config FLASH_DISABLE_CACHE64
	bool "Disable the CACHE64 cache for FlexSPI flash accesses"
	help
	  Disable cache64 cache.

endif # SOC_SERIES_MCX_N94X
```
